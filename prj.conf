## CMakeLists.txt
```
cmake_minimum_required(VERSION 3.20.0)

find_package(Zephyr REQUIRED HINTS $ENV{ZEPHYR_BASE})
project(stm32wle5_rtos_ttn_otaa)

FILE(GLOB app_sources src/*.c)
target_sources(app PRIVATE ${app_sources})
```

## prj.conf
```kconfig
# Debugger Support
CONFIG_CONSOLE=y
CONFIG_UART_CONSOLE=y

# Communication Bus Support
CONFIG_GPIO=y
CONFIG_SPI=y

# LoRa Support
CONFIG_LORA=y

# LoRaWAN Support
CONFIG_LORAWAN=y
CONFIG_HAS_SEMTECH_LORAMAC=y
CONFIG_LORAMAC_REGION_EU868=y
CONFIG_LORAWAN_SYSTEM_MAX_RX_ERROR=100

# Flash Memory Support
CONFIG_NVS=y
CONFIG_FLASH=y
CONFIG_FLASH_PAGE_LAYOUT=y
CONFIG_MPU_ALLOW_FLASH_WRITE=y

# Stack Support
CONFIG_MAIN_STACK_SIZE=2048
CONFIG_SYSTEM_WORKQUEUE_STACK_SIZE=2048

# Random Number Generation Support
CONFIG_TEST_RANDOM_GENERATOR=y

# RTC Support for Timestamp
CONFIG_RTC=y
```

## boards/lora_e5_mini.overlay
```dts
/*
 * Copyright (c) 2024 STMicroelectronics
 *
 * SPDX-License-Identifier: Apache-2.0
 */

/ {
	aliases {
		rtc = &rtc;
	};
};
```

## src/main.c
```c
/*
 * Copyright (c) 2024
 * Regis Rousseau
 * Univ Lyon, INSA Lyon, Inria, CITI, EA3720
 * SPDX-License-Identifier: Apache-2.0
 */

#include "app_lorawan.h"
#include "app_stm32_rtc.h"
#include <zephyr/logging/log.h>

//  ======== globals ============================================
static const struct gpio_dt_spec led_tx = GPIO_DT_SPEC_GET(LED_TX, gpios);
static const struct gpio_dt_spec led_rx = GPIO_DT_SPEC_GET(LED_RX, gpios);
static const struct device *rtc = DEVICE_DT_GET(DT_ALIAS(rtc));

struct values {
	int16_t vbat;
	int16_t temp;
	int16_t hum;
	int16_t vadc;
//	uint8_t *id;
//	int32_t *timestamp;
} data[MAX_SAMPLES];

//  ======== main ===============================================
int8_t main(void)
{
	const struct device *dev;
	struct values data;
	int8_t payload[MAX_SAMPLES];

    int8_t ret;
//	uint8_t dev_eui[] = LORAWAN_DEV_EUI;

	// configuration of LEDs
	gpio_pin_configure_dt(&led_tx, GPIO_OUTPUT_ACTIVE);
	gpio_pin_configure_dt(&led_rx, GPIO_OUTPUT_ACTIVE);
	gpio_pin_set_dt(&led_tx, 0);
	//gpio_pin_set_dt(&led_rx, 0);

	// initialization of LoRaWAN - TTN
	app_lorawan_init(dev);
	app_rtc_init(dev);

	printk("Geophone Measurement Simulation and Process Information - Board: %s\n", CONFIG_BOARD);
	
	// beginning forever loop (polling mode)
	while (1) {
		// constrution of random data structure
		data.vbat = sys_rand16_get() % (100 - 0 + 1) + 0;
		data.temp = (sys_rand16_get() % (100 - (-100) + 1)) + (-100);
		data.hum = sys_rand16_get() % (100 - 0 + 1) + 0;
		data.vadc = sys_rand16_get() % (3300 - 0 + 1) + 0;

		//payload->id = dev_eui;
		//payload->timestamp = app_rtc_get_time (dev);

		// transmission of packets on lorawan protocole - encode payload to bytes
		// battery needs 2 bytes

		payload[0] = (data.vbat >> 8) & 0xFF;
        payload[1] = data.vbat & 0xFF;

		// temperature needs 3 byte 327.67 max value (signed short)
		if (data.temp < 0) {
		 	payload[2] = 1 & 0xff;
		} else {
			payload[2] = 0 & 0xff;
		}
		payload[3] = (data.temp >> 8) & 0xFF;
        payload[4] = data.temp & 0xFF;

		// humidity needs 2 bytes
		payload[5] = (data.hum >> 8) & 0xFF;
        payload[6] = data.hum & 0xFF;

		// adc needs 2 bytes
		payload[7] = (data.vadc >> 8) & 0xFF;
        payload[8] = data.vadc & 0xFF;

		printk("sending random data...\n");

		gpio_pin_set_dt(&led_tx, 1);
		ret = lorawan_send(LORAWAN_PORT, payload, sizeof(payload), LORAWAN_MSG_UNCONFIRMED);
		if (ret == -EAGAIN) {
			printk("lorawan_send failed: %d. Continuing...", ret);
			k_sleep(DELAY);
			continue;
		} else if (ret < 0) {
			printk("lorawan_send failed: %d", ret);
			return(-1);
		}

		gpio_pin_set_dt(&led_tx, 0);
		k_sleep(DELAY);
	}
	return 0;
}
```

## src/app_lorawan.c
```c
/*
 * Copyright (c) 2024
 * Regis Rousseau
 * Univ Lyon, INSA Lyon, Inria, CITI, EA3720
 * SPDX-License-Identifier: Apache-2.0
 */

#include "app_lorawan.h"
#include "app_flash.h"

//  ======== globals ============================================
static const struct gpio_dt_spec led_tx = GPIO_DT_SPEC_GET(LED_TX, gpios);
static const struct gpio_dt_spec led_rx = GPIO_DT_SPEC_GET(LED_RX, gpios);

// downlink callback
static void dl_callback(uint8_t port, bool data_pending, int16_t rssi, int8_t snr, uint8_t len, const uint8_t *data)
{
	printk("downlink data received: ");
    for(int8_t i=0; i < len; i++) {
		printk("%02X ", data[i]);
	}
    printk("\n");
	printk("port: %d, pending: %d, RSSI: %ddB, SNR: %dBm\n", port, data_pending, rssi, snr);
}

// ADR change callback
static void lorwan_datarate_changed(enum lorawan_datarate dr)
{
	uint8_t unused, max_size;

	lorawan_get_payload_sizes(&unused, &max_size);
	printk("new datarate: DR_%d, max payload: %d\n", dr, max_size);
}


//  ======== app_loarwan_init ===================================
int8_t app_lorawan_init(const struct device *dev)
{
    struct lora_modem_config config;
	struct lorawan_join_config join_cfg;
	static struct nvs_fs fs;
	uint16_t dev_nonce = 0u;

    int8_t ret;
	int8_t itr = 1;
	ssize_t err;
	uint8_t dev_eui[] 	= LORAWAN_DEV_EUI;
	uint8_t join_eui[]	= LORAWAN_JOIN_EUI;
	uint8_t app_key[]	= LORAWAN_APP_KEY;

	// initialization and reading/writing the devnonce parameter
	app_flash_init(&fs);
	app_flash_init_param(&fs, NVS_DEVNONCE_ID, &dev_nonce);

	printk("starting lorawan node\n");
    // getting lora sx1276 device
	dev = DEVICE_DT_GET(DT_ALIAS(lora0));
	if (!device_is_ready(dev)) {
		printk("%s: device not ready\n", dev->name);
		return 0;
	}

	printk("starting lorawan stack\n");
    // starting device
	ret = lorawan_set_region(LORAWAN_REGION_EU868);
	if (ret < 0) {
		printk("lorawan_set_region failed: %d\n", ret);
		return 0;
	}

	ret = lorawan_start();
	if (ret < 0) {
		printk("lorawan_start failed. error: %d\n", ret);
		return 0;
	} else {
			k_sleep(K_MSEC(500));
	}

	// enable ADR
    // lorawan_enable_adr(false);
	lorawan_enable_adr(true);

    // enable callbacks
	struct lorawan_downlink_cb downlink_cb = {
		.port = LW_RECV_PORT_ANY,
		.cb = dl_callback
	};
	lorawan_register_downlink_callback(&downlink_cb);
	lorawan_register_dr_changed_callback(lorwan_datarate_changed);  

	// configuration of lorawan parameters 
    join_cfg.mode = LORAWAN_ACT_OTAA;
	join_cfg.dev_eui = dev_eui;
	join_cfg.otaa.join_eui = join_eui;
	join_cfg.otaa.app_key = app_key;
	join_cfg.otaa.nwk_key = app_key;
	join_cfg.otaa.dev_nonce = dev_nonce;

	do {
		printk("joining network over OTAA, dev nonce %d, attempt %d\n", join_cfg.otaa.dev_nonce, itr++);
		gpio_pin_set_dt(&led_rx, 1);
		ret = lorawan_join(&join_cfg);
		if (ret < 0) {
			if ((ret =-ETIMEDOUT)) {
				printk("timed-out waiting for response.\n");
			} else {
				printk("join network failed. error: %d\n", ret);
			}
		} else {
			printk("OTAA join successful\n");
		}

		dev_nonce++;
		join_cfg.otaa.dev_nonce = dev_nonce;

		// save value away in Non-Volatile Storage.
		err = nvs_write(&fs, NVS_DEVNONCE_ID, &dev_nonce, sizeof(dev_nonce));
		if (err < 0) {
			printk("NVS: failed to write id %d. error: %d\n", NVS_DEVNONCE_ID, err);
		}

		if (ret < 0) {
			// if failed, wait before re-trying.
			k_sleep(K_MSEC(10000));
		}
	} while (ret != 0);

//	gpio_pin_set_dt(&led_rx, 0);
    return 0;
}

  
    
```

## src/app_lorawan.h
```c
/*
 * Copyright (c) 2024
 * Regis Rousseau
 * Univ Lyon, INSA Lyon, Inria, CITI, EA3720
 * SPDX-License-Identifier: Apache-2.0
 */

#ifndef APP_LORAWAN_H
#define APP_LORAWAN_H

//  ======== includes =============================================
#include <zephyr/device.h>
#include <zephyr/kernel.h>
#include <zephyr/drivers/gpio.h>
#include <zephyr/drivers/lora.h>
#include <zephyr/lorawan/lorawan.h>
#include <zephyr/random/random.h>

//  ======== defines ==============================================
/* led control */
#define LED_TX                  DT_ALIAS(ledtx)      // declared in device tree 
#define LED_RX                  DT_ALIAS(ledrx)      // declared in device tree
//#define DELAY 			        K_MSEC(30000)
#define DELAY                   K_MINUTES(15)
#define MAX_SAMPLES             9            

/* customize based on network configuration */
#define LORAWAN_DEV_EUI			{ 0x70, 0xB3, 0xD5, 0x7E, 0xD0, 0x06, 0xB4, 0x71 }
#define LORAWAN_JOIN_EUI		{ 0x00, 0x00, 0x00, 0x00, 0x00, 0x00, 0x00, 0x00 }
#define LORAWAN_APP_KEY			{ 0xC7, 0x32, 0x0F, 0x37, 0xFF, 0x62, 0xE0, 0xA8, 0x4E, 0x94, 0xC1, 0x9C, 0x27, 0x2B, 0xFA, 0x4C }
#define LORAWAN_PORT            2       // application port

//  ======== prototypes ============================================
int8_t app_lorawan_init(const struct device *dev);

#endif /* APP_LORAWAN__H */
```

## src/app_stm32_rtc.c
```c
/*
 * Copyright (c) 2024
 * Regis Rousseau
 * Univ Lyon, INSA Lyon, Inria, CITI, EA3720
 * SPDX-License-Identifier: Apache-2.0
 */

#include "app_stm32_rtc.h"

//  ========== app_rtc_init ================================================================
int8_t app_rtc_init(const struct device *dev)
{
    int8_t ret = 0;
    
    // getting ds3231 rtc i2c device (SDA: P0.09, SCL:P0.0)
    dev = DEVICE_DT_GET(DT_ALIAS(rtc));
    if (dev == 0) {
        printk("error: no =rtc device found\n");
		return 0;
	}

    if (!device_is_ready(dev)) {
		printk("error: rtc is not ready\n");
		return 0;
	} else {
        printk("- found device \"%s\", getting rtc data\n", dev->name);
    }
    return 0;
}

//  ========== app_rtc_get_time ============================================================
int32_t* app_rtc_get_time (const struct device *dev)
{
    int8_t ret = 0;
	struct rtc_time time = {
		.tm_year = 2024 - 1900,
		.tm_mon = 11 - 1,
		.tm_mday = 17,
		.tm_hour = 4,
		.tm_min = 19,
		.tm_sec = 0,
	};
	int32_t buffer[sizeof(time)];

	dev = DEVICE_DT_GET(DT_ALIAS(rtc));

	ret = rtc_set_time(dev, &time);
	if (ret < 0) {
		printk("Cannot write date time: %d\n", ret);
		return ret;
	}
	
    ret = rtc_get_time(dev, &time);
	if (ret < 0) {
		printk("cannot read date time: %d\n", ret);
		return ret;
	}

	// 	// putting timestamp in fisrt page for this test
 	memcpy(buffer, &time, sizeof(time));
	for (int8_t itr = 0; itr < sizeof(buffer); itr) {
		printk("RTC date and time: %04d-%02d-%02d %02d:%02d:%02d\n", buffer[itr]);
	}

	// printk("RTC date and time: %04d-%02d-%02d %02d:%02d:%02d\n", time.tm_year + 1900,
	//        time.tm_mon + 1, time.tm_mday, time.tm_hour, time.tm_min, time.tm_sec);
    return buffer;
}
```

## src/app_stm32_rtc.h
```c
/*
 * Copyright (c) 2024
 * Regis Rousseau
 * Univ Lyon, INSA Lyon, Inria, CITI, EA3720
 * SPDX-License-Identifier: Apache-2.0
 */

#ifndef APP_STM32_RTC_H
#define APP_STM32_RTC_H

//  ======== includes ==============================================
#include <zephyr/kernel.h>
#include <zephyr/device.h>
#include <zephyr/devicetree.h>
#include <zephyr/drivers/rtc.h>
#include <zephyr/drivers/counter.h>

//  ======== defines ===============================================

//  ======== prototypes ============================================
int8_t app_rtc_init(const struct device *dev);
int32_t* app_rtc_get_time(const struct device *dev);
 
#endif /* APP_STM32_RTC_H */
```
